## drivers/input/fingerprint/Kconfig
```kconfig
menuconfig INPUT_FINGERPRINT
	bool "Fingerprint"
	default y
	help
	  Say Y here, and a list of supported fingerprint will be displayed.
	  This option doesn't affect the kernel.

	  If unsure, say Y.

if INPUT_FINGERPRINT

config FINGERPRINT_DETECT
	tristate "fingerprint detect support"
	depends on SPI_MASTER

config FINGERPRINT_FPC
   tristate "fpc fingerprint sensor support"
   depends on SPI_MASTER

config FINGERPRINT_GOODIX
	tristate "goodix fingerprint sensor support"
	depends on SPI_MASTER

config FPF_TS_PRESSURE
       default n
       tristate "Touchscreen input driver uses ABS_MT_PRESSURE"

config FPF_KAD
       default n
       tristate "kernel ambient display enabled"
endif
```
